## prj.conf
```kconfig
CONFIG_LOG=y
CONFIG_LOG_BACKEND_RTT=y
CONFIG_LOG_BACKEND_UART=n
CONFIG_USE_SEGGER_RTT=y

CONFIG_NRF_MODEM_LIB=y
CONFIG_LTE_LINK_CONTROL=y
CONFIG_LTE_NETWORK_MODE_LTE_M_GPS=y

CONFIG_FPU=y
CONFIG_PICOLIBC_IO_FLOAT=y
```

## src/main.c
```c
#include <modem/lte_lc.h>
#include <modem/nrf_modem_lib.h>
#include <nrf_modem_gnss.h>
#include <zephyr/kernel.h>
#include <zephyr/logging/log.h>

#include "brid_tx.h"
#include "uav.h"

LOG_MODULE_REGISTER(main, LOG_LEVEL_INF);

static struct nrf_modem_gnss_pvt_data_frame pvt_data;

static void gnss_event_handler(int event) {
    switch (event) {
        case NRF_MODEM_GNSS_EVT_PVT:
            LOG_INF("NRF_MODEM_GNSS_EVT_PVT");
            break;
        case NRF_MODEM_GNSS_EVT_FIX:
            LOG_INF("NRF_MODEM_GNSS_EVT_FIX");
            break;
        case NRF_MODEM_GNSS_EVT_NMEA:
            LOG_INF("NRF_MODEM_GNSS_EVT_NMEA");
            break;
        case NRF_MODEM_GNSS_EVT_AGNSS_REQ:
            LOG_INF("NRF_MODEM_GNSS_EVT_AGNSS_REQ");
            break;
        case NRF_MODEM_GNSS_EVT_BLOCKED:
            LOG_INF("NRF_MODEM_GNSS_EVT_BLOCKED");
            break;
        case NRF_MODEM_GNSS_EVT_UNBLOCKED:
            LOG_INF("NRF_MODEM_GNSS_EVT_UNBLOCKED");
            break;
        case NRF_MODEM_GNSS_EVT_PERIODIC_WAKEUP:
            LOG_INF("NRF_MODEM_GNSS_EVT_PERIODIC_WAKEUP");
            break;
        case NRF_MODEM_GNSS_EVT_SLEEP_AFTER_TIMEOUT:
            LOG_INF("NRF_MODEM_GNSS_EVT_SLEEP_AFTER_TIMEOUT");
            break;
        case NRF_MODEM_GNSS_EVT_SLEEP_AFTER_FIX:
            LOG_INF("NRF_MODEM_GNSS_EVT_SLEEP_AFTER_FIX");
            break;
        default:
            LOG_WRN("Unknown GNSS event: %d", event);
            break;
    }
}

int main(void) {
    int rc;
    int tracked = 0;
    int used = 0;
    uint8_t slot = 0;
    uint8_t counter = 0;

    LOG_INF("librid %s", rid_version_to_string());

    LOG_INF("Initializing the modem firmware.");
    rc = nrf_modem_lib_init();
    if (rc < 0) {
        LOG_ERR("Modem init failed: %d", rc);
        return rc;
    }

    rc = brid_tx_init();
    if (rc < 0) {
        LOG_ERR("UART transport init failed: %d", rc);
        return rc;
    }

    rc = lte_lc_func_mode_set(LTE_LC_FUNC_MODE_ACTIVATE_GNSS);
    if (rc < 0) {
        LOG_ERR("Failed to activate GNSS: %d", rc);
        return rc;
    }

    rc = nrf_modem_gnss_event_handler_set(gnss_event_handler);
    if (rc < 0) {
        LOG_ERR("Failed to set GNSS event handler: %d", rc);
        return rc;
    }

    /* Continuous 1Hz navigation mode. */
    rc = nrf_modem_gnss_fix_interval_set(1);
    if (rc < 0) {
        LOG_ERR("Failed to set fix interval: %d", rc);
        return rc;
    }

    rc = nrf_modem_gnss_start();
    if (rc < 0) {
        LOG_ERR("Failed to start GNSS: %d", rc);
        return rc;
    }
    LOG_INF("GNSS started. Broadcasting RID at 4 Hz.");

    while (1) {
        /* Read latest PVT data and update RID messages on fix. */
        rc = nrf_modem_gnss_read(&pvt_data, sizeof(pvt_data), NRF_MODEM_GNSS_DATA_PVT);

        if (rc == 0 && (pvt_data.flags & NRF_MODEM_GNSS_PVT_FLAG_FIX_VALID)) {
            LOG_INF("Fix: lat=%.06f lon=%.06f", pvt_data.latitude, pvt_data.longitude);
            uav_location_update(&pvt_data);
            uav_system_update(&pvt_data);
        }

        for (int i = 0; i < NRF_MODEM_GNSS_MAX_SATELLITES; i++) {
            /* No data in this slot */
            if (pvt_data.sv[i].sv == 0) {
                break;
            }
            const char *used_str = "";

            /* We have a satellite */
            tracked++;
            if (pvt_data.sv[i].flags & NRF_MODEM_GNSS_SV_FLAG_USED_IN_FIX) {
                /* This satellite is used in fix */
                used++;
                used_str = " *";
            }
            LOG_INF(
                "  SV %3d: cn0=%.01f el=%d az=%d%s",
                pvt_data.sv[i].sv,
                pvt_data.sv[i].cn0 / 10.0,
                pvt_data.sv[i].elevation,
                pvt_data.sv[i].azimuth,
                used_str
            );
        }

        /* 4-slot rotation at 250 ms intervals. */
        switch (slot) {
            case 0:
            case 2: {
                rid_location_t location;
                uav_location_get(&location);
                brid_tx_send_legacy(&location, counter++);
                break;
            }
            case 1: {
                rid_basic_id_t bid;
                uav_basic_id_get(&bid);
                brid_tx_send_legacy(&bid, counter++);
                break;
            }
            case 3: {
                rid_system_t sys;
                uav_system_get(&sys);
                brid_tx_send_legacy(&sys, counter++);
                break;
            }
        }

        slot = (slot + 1) % 4;
        k_sleep(K_MSEC(250));
    }
    return 0;
}
```

## src/brid_tx.c
```c
/*
 * UART transport for sending RID advertising payloads to the nRF5340.
 *
 * Frame format:
 *   [0xAA] [0x55] [cmd] [len] [payload...]
 *
 * Legacy payload (27 bytes):
 *   [app_code=0x0D] [counter] [25 bytes RID message]
 */

#include <string.h>
#include <zephyr/device.h>
#include <zephyr/drivers/uart.h>
#include <zephyr/kernel.h>
#include <zephyr/logging/log.h>

#include <rid/transport.h>

#include "brid_tx.h"

LOG_MODULE_REGISTER(brid_tx, LOG_LEVEL_INF);

#define SYNC_0 0xAA /* 0b10101010 */
#define SYNC_1 0x55 /* 0b01010101 */

#define CMD_LEGACY_ADV_UPDATE 0x01

#define RID_MESSAGE_SIZE 25

static const struct device *uart_dev = DEVICE_DT_GET(DT_NODELABEL(uart1));

static void uart_write_buffer(const uint8_t *buf, size_t len) {
    for (size_t i = 0; i < len; i++) {
        uart_poll_out(uart_dev, buf[i]);
    }
}

int brid_tx_init(void) {
    if (!device_is_ready(uart_dev)) {
        LOG_ERR("UART1 device not ready");
        return -ENODEV;
    }
    LOG_INF("UART1 transport ready.");
    return 0;
}

int brid_tx_send_legacy(const void *msg, uint8_t counter) {
    /* Payload: app_code (1) + counter (1) + message (25) = 27 bytes. */
    const uint8_t payload_len = 1 + 1 + RID_MESSAGE_SIZE;
    uint8_t header[4] = {
        SYNC_0,
        SYNC_1,
        CMD_LEGACY_ADV_UPDATE,
        payload_len,
    };
    uint8_t payload_header[2] = {
        RID_TRANSPORT_BLUETOOTH_APP_CODE, /* 0x0D */
        counter,
    };

    uart_write_buffer(header, sizeof(header));
    uart_write_buffer(payload_header, sizeof(payload_header));
    uart_write_buffer((const uint8_t *)msg, RID_MESSAGE_SIZE);

    return 0;
}
```

## src/brid_tx.h
```c
#ifndef BRID_TX_H
#define BRID_TX_H

#include <stdint.h>

/**
 * Initialize the UART transport to the nRF5340 BLE radio.
 *
 * @return 0 on success, negative errno on failure.
 */
int brid_tx_init(void);

/**
 * Send a single 25-byte RID message as a BLE Legacy advertising
 * update over the UART link.
 *
 * @param msg Pointer to a 25-byte RID message.
 * @param counter Incrementing message counter.
 * @return 0 on success, negative errno on failure.
 */
int brid_tx_send_legacy(const void *msg, uint8_t counter);

#endif /* BRID_TX_H */
```

## src/uav.c
```c
#include <string.h>
#include <zephyr/logging/log.h>
#include <zephyr/sys/timeutil.h>

#include "uav.h"

LOG_MODULE_REGISTER(uav, LOG_LEVEL_INF);

static rid_basic_id_t basic_id;
static rid_location_t location;
static rid_system_t system;

void uav_basic_id_get(rid_basic_id_t *msg) {
    rid_basic_id_init(&basic_id);
    rid_basic_id_set_type(&basic_id, RID_ID_TYPE_SERIAL_NUMBER);
    rid_basic_id_set_ua_type(&basic_id, RID_UA_TYPE_HELICOPTER_OR_MULTIROTOR);
    rid_basic_id_set_uas_id(&basic_id, "1ABCD2345EF678XYZ");
    memcpy(msg, &basic_id, sizeof(rid_basic_id_t));
}

void uav_location_get(rid_location_t *msg) {
    memcpy(msg, &location, sizeof(rid_location_t));
}

void uav_system_get(rid_system_t *msg) {
    memcpy(msg, &system, sizeof(rid_system_t));
}

void uav_location_update(const struct nrf_modem_gnss_pvt_data_frame *pvt) {
    rid_location_init(&location);
    rid_location_set_operational_status(&location, RID_OPERATIONAL_STATUS_AIRBORNE);
    rid_location_set_height_type(&location, RID_HEIGHT_TYPE_AGL);
    rid_location_set_latitude(&location, pvt->latitude);
    rid_location_set_longitude(&location, pvt->longitude);
    rid_location_set_geodetic_altitude(&location, pvt->altitude);
    rid_location_set_speed(&location, pvt->speed);
    rid_location_set_vertical_speed(&location, pvt->vertical_speed);
    rid_location_set_track_direction(&location, (uint16_t)pvt->heading);

    LOG_HEXDUMP_INF(&location, sizeof(location), "Location");
}

void uav_system_update(const struct nrf_modem_gnss_pvt_data_frame *pvt) {
    struct tm tm = {
        .tm_year = pvt->datetime.year - 1900,
        .tm_mon = pvt->datetime.month - 1,
        .tm_mday = pvt->datetime.day,
        .tm_hour = pvt->datetime.hour,
        .tm_min = pvt->datetime.minute,
        .tm_sec = pvt->datetime.seconds,
    };
    uint32_t unixtime = (uint32_t)timeutil_timegm(&tm);

    rid_system_init(&system);
    rid_system_set_operator_location_type(&system, RID_OPERATOR_LOCATION_TYPE_TAKEOFF);
    rid_system_set_classification_type(&system, RID_CLASSIFICATION_TYPE_UNDECLARED);
    rid_system_set_operator_latitude(&system, 62.6833379);
    rid_system_set_operator_longitude(&system, 21.9833208);
    rid_system_set_area_count(&system, 1);
    rid_system_set_area_radius(&system, 0);
    rid_system_set_area_ceiling(&system, 120.0f);
    rid_system_set_area_floor(&system, 0.0f);
    rid_system_set_unixtime(&system, unixtime);

    LOG_HEXDUMP_INF(&system, sizeof(system), "System");
}

void uav_message_pack_get(rid_message_pack_t *pack) {
    rid_basic_id_t bid;

    rid_message_pack_init(pack);
    uav_basic_id_get(&bid);
    rid_message_pack_add_message(pack, &bid);
    rid_message_pack_add_message(pack, &location);
    rid_message_pack_add_message(pack, &system);
}
```

## src/uav.h
```c
#ifndef UAV_H
#define UAV_H

#include <nrf_modem_gnss.h>
#include <rid/rid.h>

void uav_location_update(const struct nrf_modem_gnss_pvt_data_frame *pvt);
void uav_system_update(const struct nrf_modem_gnss_pvt_data_frame *pvt);

void uav_basic_id_get(rid_basic_id_t *msg);
void uav_location_get(rid_location_t *msg);
void uav_system_get(rid_system_t *msg);
void uav_message_pack_get(rid_message_pack_t *pack);

#endif /* UAV_H */
```
