## CMakeLists.txt
```
cmake_minimum_required(VERSION 3.20.0)

find_package(Zephyr REQUIRED HINTS $ENV{ZEPHYR_BASE})
project(009_segger_rtt)

zephyr_library_sources(src/main.c)
```

## prj.conf
```kconfig
CONFIG_LOG=y
CONFIG_LOG_BACKEND_RTT=y
CONFIG_LOG_BACKEND_UART=n
CONFIG_USE_SEGGER_RTT=y
```

## src/main.c
```c
#include <zephyr/kernel.h>
#include <zephyr/logging/log.h>

LOG_MODULE_REGISTER(segger_rtt, LOG_LEVEL_INF);

int main(void) {
    while (1) {
        LOG_INF("Running on %s (%s)", CONFIG_BOARD, CONFIG_SOC);
        k_sleep(K_SECONDS(1));
    }
    return 0;
}
```
